## conf/machine/rk3568-icore-ctouch3.1.conf
```bitbake
# Copyright (c) 2020, Rockchip Electronics Co., Ltd
# Released under the MIT license (see COPYING.MIT for the terms)

#@TYPE: Machine
#@NAME: RK3568 EVB

require conf/machine/rockchip-rk3566-evb.conf
MACHINE_FEATURES += "alsa bluetooth wifi touchscreen "

KERNEL_DEVICETREE = "rockchip/rk3568-icore-linux-ctouch31.dtb"

SERIAL_CONSOLES = "115200;ttyFIQ0"


# Wi-Fi/Bluetooth: Panasonic PAN9028 (NXP 88W8987)
MACHINEOVERRIDES =. "pan9028:"
RK_WIFIBT_RRECOMMENDS = " \
	kernel-module-nxp-wlan \
	firmware-nxp-wifi-8987 \
"
```
