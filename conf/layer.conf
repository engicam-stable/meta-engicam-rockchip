## conf/layer.conf
```bitbake
# We have a conf and classes directory, add to BBPATH
BBPATH .= ":${LAYERDIR}"

# We have recipes-* directories, add to BBFILES
BBFILES += "${LAYERDIR}/recipes-*/*/*.bb \
            ${LAYERDIR}/recipes-*/*/*.bbappend"

BBFILE_COLLECTIONS += "meta-engicam-rockchip"
BBFILE_PATTERN_meta-engicam-rockchip = "^${LAYERDIR}/"
BBFILE_PRIORITY_meta-engicam-rockchip = "6"

LAYERDEPENDS_meta-engicam-rockchip = "core"
LAYERSERIES_COMPAT_meta-engicam-rockchip = "kirkstone"
```

## conf/machine/include/px30-icore.inc
```bitbake
# Copyright (c) 2019, Fuzhou Rockchip Electronics Co., Ltd
# Released under the MIT license (see COPYING.MIT for the terms)

SOC_FAMILY ?= "px30"
require conf/machine/include/rockchip-arm64-common.inc

KBUILD_DEFCONFIG = "defconfig"

MALI_GPU := "bifrost-g31"
MALI_VERSION := "g2p0"

RK_ISP_VERSION := "1"

DISTRO_FEATURES += " pam wayland opengl"
INIT_MANAGER = "systemd"
BBMASK = "meta-rockchip/recipes-core/systemd/"
```

## conf/machine/px30-icore-ctouch2-amp10.conf
```bitbake
# Copyright (c) 2019, Fuzhou Rockchip Electronics Co., Ltd
# Released under the MIT license (see COPYING.MIT for the terms)

#@TYPE: Machine
#@NAME: PX30 CTOUCH 2.0

#require conf/machine/include/px30.inc
require conf/machine/include/px30-icore.inc
PREFERRED_PROVIDER_virtual/bootloader = "u-boot"

PREFERRED_PROVIDER_virtual/kernel = "linux-rockchip-engicam"
PREFERRED_VERSION_linux-rockchip-eng = "5.10%"

KERNEL_DEVICETREE = "rockchip/px30-icore-ctouch2-amp10.dtb"

UBOOT_MACHINE = "evb-px30_defconfig"

RK_WIFIBT_FIRMWARES = " \
	rkwifibt-firmware-ap6212a1-wifi \
	rkwifibt-firmware-ap6212a1-bt \
	brcm-tools \
"

WKS_FILE = "engicam-gptdisk.wks.in"

SERIAL_CONSOLES = "115200;ttyS2"
```

## conf/machine/px30-icore-starterkit.conf
```bitbake
# Copyright (c) 2019, Fuzhou Rockchip Electronics Co., Ltd
# Released under the MIT license (see COPYING.MIT for the terms)

#@TYPE: Machine
#@NAME: PX30 EVB

require conf/machine/include/px30-icore.inc

PREFERRED_PROVIDER_virtual/bootloader = "u-boot"

PREFERRED_PROVIDER_virtual/kernel = "linux-engicam-rockchip"

KERNEL_DEVICETREE = "rockchip/px30-engicam-px30-core-edimm2.2.dtb"

UBOOT_MACHINE = "evb-px30_defconfig"

RK_WIFIBT_FIRMWARES = " \
	rkwifibt-firmware-ap6212a1-wifi \
	rkwifibt-firmware-ap6212a1-bt \
	brcm-tools \
"
WKS_FILE = "engicam-gptdisk.wks.in"

SERIAL_CONSOLES = "115200;ttyS2"
```
